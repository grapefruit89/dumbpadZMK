## config/boards/shields/dumbpad/Kconfig.defconfig
```kconfig
if SHIELD_DUMBPAD

config ZMK_KEYBOARD_NAME
    default "Dumbpad"

config ZMK_SPLIT
    default n

endif # SHIELD_DUMBPAD
```

## config/boards/shields/dumbpad/Kconfig.shield
```kconfig
config SHIELD_DUMBPAD
    def_bool $(shields_list_contains,dumbpad)

config SHIELD_DUMBPAD_OLED
    def_bool $(shields_list_contains,dumbpad_oled)
```
